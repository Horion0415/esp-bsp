## examples/p4_eye_timed_shooting/main/Kconfig.projbuild
```kconfig
menu "Example Configuration"

    config EXAMPLE_ENABLE_MIPI_CSI_CAM_SENSOR
        bool "Enable MIPI CSI Camera Sensor"
        default y
        depends on SOC_MIPI_CSI_SUPPORTED

    if EXAMPLE_ENABLE_MIPI_CSI_CAM_SENSOR
        config EXAMPLE_MIPI_CSI_SCCB_I2C_PORT
            int "MIPI CSI SCCB I2C Port Number"
            default 0
            range 0 1

        config EXAMPLE_MIPI_CSI_SCCB_I2C_SCL_PIN
            int "MIPI CSI SCCB I2C SCL Pin"
            default 34
            range -1 56

        config EXAMPLE_MIPI_CSI_SCCB_I2C_SDA_PIN
            int "MIPI CSI SCCB I2C SDA Pin"
            default 31
            range -1 56

        config EXAMPLE_MIPI_CSI_SCCB_I2C_FREQ
            int "MIPI CSI SCCB I2C Frequency"
            default 100000
            range 100000 400000
            help
                Increasing this value can reduce the initialization time of the camera sensor.
                Please refer to the relevant instructions of the camera sensor to adjust the value.

        config EXAMPLE_MIPI_CSI_CAM_SENSOR_RESET_PIN
            int "MIPI CSI Camera Sensor Reset Pin"
            default -1
            range -1 56

        config EXAMPLE_MIPI_CSI_CAM_SENSOR_PWDN_PIN
            int "MIPI CSI Camera Sensor Power Down Pin"
            default -1
            range -1 56
    endif

    config EXAMPLE_ENABLE_PRINT_FPS_RATE_VALUE
        bool "enable print fps rate value"
        default y
        
    config EXAMPLE_CAM_BUF_COUNT
        int "Camera Buffer Count"
        default 2
        range 2 3

    choice
        prompt "Choose the color format of the LCD"
        default LCD_PIXEL_FORMAT_RGB565
            config LCD_PIXEL_FORMAT_RGB565
                bool "RGB565"

            config LCD_PIXEL_FORMAT_RGB888
                bool "RGB888"
    endchoice

    config EXAMPLE_ENABLE_CAM_SENSOR_PIC_VFLIP
        bool "Enable Camera Sensor Picture Vertical Flip"
        default y
        help
            Select this option, enable camera sensor picture vertical flip.

    config EXAMPLE_ENABLE_CAM_SENSOR_PIC_HFLIP
        bool "Enable Camera Sensor Picture Horizontal Flip"
        default y
        help
            Select this option, enable camera sensor picture horizontal flip.

    config SMTP_SERVER
        string "Mail Server"
        default "smtp.googlemail.com"
        help
            Target domain for the example to connect to.

    config SMTP_PORT_NUMBER
        string "Mail port number"
        default "587"
        help
            Mail port number for the example to connect to.

    config SMTP_SENDER_MAIL
        string "Sender email"
        default "sender.email@gmail.com"
        help
            Sender's Email address

    config SMTP_SENDER_PASSWORD
        string "Sender password"
        default "password@123"
        help
            Sender's email password

    config SMTP_RECIPIENT_MAIL
        string "Recipient email"
        default "recipient.email@gmail.com"
        help
            Recipient's email

endmenu
```
