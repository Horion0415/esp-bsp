## examples/p4_eye_capture_picture/main/Kconfig.projbuild
```kconfig
menu "Example Configuration"

    config EXAMPLE_ENABLE_MIPI_CSI_CAM_SENSOR
        bool "Enable MIPI CSI Camera Sensor"
        default y
        depends on SOC_MIPI_CSI_SUPPORTED

    if EXAMPLE_ENABLE_MIPI_CSI_CAM_SENSOR
        config EXAMPLE_MIPI_CSI_SCCB_I2C_PORT
            int "MIPI CSI SCCB I2C Port Number"
            default 0
            range 0 1

        config EXAMPLE_MIPI_CSI_SCCB_I2C_SCL_PIN
            int "MIPI CSI SCCB I2C SCL Pin"
            default 34
            range -1 56

        config EXAMPLE_MIPI_CSI_SCCB_I2C_SDA_PIN
            int "MIPI CSI SCCB I2C SDA Pin"
            default 31
            range -1 56

        config EXAMPLE_MIPI_CSI_SCCB_I2C_FREQ
            int "MIPI CSI SCCB I2C Frequency"
            default 100000
            range 100000 400000
            help
                Increasing this value can reduce the initialization time of the camera sensor.
                Please refer to the relevant instructions of the camera sensor to adjust the value.

        config EXAMPLE_MIPI_CSI_CAM_SENSOR_RESET_PIN
            int "MIPI CSI Camera Sensor Reset Pin"
            default -1
            range -1 56

        config EXAMPLE_MIPI_CSI_CAM_SENSOR_PWDN_PIN
            int "MIPI CSI Camera Sensor Power Down Pin"
            default -1
            range -1 56
    endif

    config EXAMPLE_ENABLE_PRINT_FPS_RATE_VALUE
        bool "enable print fps rate value"
        default y
        
    config EXAMPLE_CAM_BUF_COUNT
        int "Camera Buffer Count"
        default 2
        range 2 3

    choice
        prompt "Choose the color format of the LCD"
        default LCD_PIXEL_FORMAT_RGB565
            config LCD_PIXEL_FORMAT_RGB565
                bool "RGB565"

            config LCD_PIXEL_FORMAT_RGB888
                bool "RGB888"
    endchoice

    config EXAMPLE_ENABLE_CAM_SENSOR_PIC_VFLIP
        bool "Enable Camera Sensor Picture Vertical Flip"
        default y
        help
            Select this option, enable camera sensor picture vertical flip.

    config EXAMPLE_ENABLE_CAM_SENSOR_PIC_HFLIP
        bool "Enable Camera Sensor Picture Horizontal Flip"
        default y
        help
            Select this option, enable camera sensor picture horizontal flip.

endmenu

menu "TinyUSB MSC Example Configuration"

    orsource "$IDF_PATH/examples/common_components/env_caps/$IDF_TARGET/Kconfig.env_caps"

    choice EXAMPLE_STORAGE_MEDIA
        prompt "Storage Media Used"
        default EXAMPLE_STORAGE_MEDIA_SDMMC
        help
            Select the storage media that is exposed to USB host.

        config EXAMPLE_STORAGE_MEDIA_SPIFLASH
            bool "SPI FLASH"

        config EXAMPLE_STORAGE_MEDIA_SDMMC
            bool "SDMMC CARD"
            depends on IDF_TARGET_ESP32S3 || IDF_TARGET_ESP32P4
    endchoice

    if EXAMPLE_STORAGE_MEDIA_SDMMC

        choice EXAMPLE_SDMMC_BUS_WIDTH
            prompt "SD/MMC bus width"
            default EXAMPLE_SDMMC_BUS_WIDTH_4
            help
                Select the bus width of SD or MMC interface.
                Note that even if 1 line mode is used, D3 pin of the SD card must
                have a pull-up resistor connected. Otherwise the card may enter
                SPI mode, the only way to recover from which is to cycle power to the card.

            config EXAMPLE_SDMMC_BUS_WIDTH_4
                bool "4 lines (D0 - D3)"

            config EXAMPLE_SDMMC_BUS_WIDTH_1
                bool "1 line (D0)"
        endchoice

        if SOC_SDMMC_USE_GPIO_MATRIX

            config EXAMPLE_PIN_CMD
                int "CMD GPIO number"
                range ENV_GPIO_RANGE_MIN ENV_GPIO_IN_RANGE_MAX
                default 35 if IDF_TARGET_ESP32S3
                default 44 if IDF_TARGET_ESP32P4

            config EXAMPLE_PIN_CLK
                int "CLK GPIO number"
                range ENV_GPIO_RANGE_MIN ENV_GPIO_OUT_RANGE_MAX
                default 36 if IDF_TARGET_ESP32S3
                default 43 if IDF_TARGET_ESP32P4

            config EXAMPLE_PIN_D0
                int "D0 GPIO number"
                range ENV_GPIO_RANGE_MIN ENV_GPIO_IN_RANGE_MAX
                default 37 if IDF_TARGET_ESP32S3
                default 39 if IDF_TARGET_ESP32P4

            if EXAMPLE_SDMMC_BUS_WIDTH_4

                config EXAMPLE_PIN_D1
                    int "D1 GPIO number"
                    range ENV_GPIO_RANGE_MIN ENV_GPIO_IN_RANGE_MAX
                    default 38 if IDF_TARGET_ESP32S3
                    default 40 if IDF_TARGET_ESP32P4

                config EXAMPLE_PIN_D2
                    int "D2 GPIO number"
                    range ENV_GPIO_RANGE_MIN ENV_GPIO_IN_RANGE_MAX
                    default 33 if IDF_TARGET_ESP32S3
                    default 41 if IDF_TARGET_ESP32P4

                config EXAMPLE_PIN_D3
                    int "D3 GPIO number"
                    range ENV_GPIO_RANGE_MIN ENV_GPIO_IN_RANGE_MAX
                    default 34 if IDF_TARGET_ESP32S3
                    default 42 if IDF_TARGET_ESP32P4

            endif  # EXAMPLE_SDMMC_BUS_WIDTH_4

        endif  # SOC_SDMMC_USE_GPIO_MATRIX

    endif  # EXAMPLE_STORAGE_MEDIA_SDMMC

endmenu
```
